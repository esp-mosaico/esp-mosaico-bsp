## components/mosaico_nand_storage/test_app/sdkconfig.defaults
```kconfig
CONFIG_MOSAICO_NAND_STORAGE_ENABLE=y
CONFIG_MOSAICO_NAND_STORAGE_QIO=y
CONFIG_MOSAICO_NAND_STORAGE_POLL_SHORT=y
CONFIG_MOSAICO_NAND_STORAGE_READ_CACHE_KIB=32
CONFIG_MOSAICO_NAND_STORAGE_RECLAIM=y
CONFIG_NAND_FLASH_ENABLE_BDL=y
CONFIG_LITTLEFS_CACHE_SIZE=2048
CONFIG_SPIRAM=y
CONFIG_SPIRAM_MODE_OCT=y
CONFIG_SPIRAM_SPEED_250M=y
CONFIG_SPIRAM_MEMTEST=n
CONFIG_FREERTOS_HZ=1000
CONFIG_UNITY_ENABLE_FIXTURE=n
CONFIG_UNITY_ENABLE_IDF_TEST_RUNNER=y
CONFIG_ESP_TASK_WDT_INIT=n
CONFIG_ESP_MAIN_TASK_STACK_SIZE=8192
CONFIG_PARTITION_TABLE_SINGLE_APP_LARGE=y
```
