## Kconfig
```kconfig
menu "ESP-Mosaico BSP"

    config BSP_CO5300_ENABLE_TE
        bool "Enable CO5300 TE anti-tearing synchronization"
        default y
        help
            Enable the CO5300 tearing-effect output and connect GPIO43 to the
            esp_lvgl_adapter TE synchronization path. The BSP default display
            configuration uses TE_SYNC when this option is enabled.

            Disable this option to omit the CO5300 TE-enable command and use
            the normal SPI display path without a TE interrupt.

    config BSP_LCD_QSPI_DRIVE_CAP
        int "QSPI LCD bus pin drive strength (0-3)"
        range 0 3
        default 0
        help
            GPIO drive capability for the CO5300 QSPI bus pins: SCL and DATA0-DATA3.
            Lower values reduce edge rate and RF emissions (useful for Wi-Fi/BLE
            coexistence). 0 = weakest (GPIO_DRIVE_CAP_0), 3 = strongest.
            Default is 0. Increase if display signal integrity fails at high clock.

    config BSP_NAND_USE_QIO
        bool "Use QIO mode for SPI NAND"
        default n

    config BSP_MOTOR_ENABLE_PWM
        bool "Enable LEDC PWM motor control"
        default y

    config BSP_VCC_3V3_RAMP_MS
        int "VCC_3V3 soft-start ramp time (ms)"
        range 0 1000
        default 50
        help
            Sweep the duty cycle on the VCC_3V3 enable GPIO over this time so the
            high-side switch opens gradually. Set to 0 to drive the pin directly.

endmenu
```

## components/mosaico_module_camera/Kconfig
```kconfig
menu "Mosaico Camera Module"

    config MOSAICO_MODULE_CAMERA
        bool "Enable the Mosaico DVP camera"
        default y
        select ESP_VIDEO_ENABLE_DVP_VIDEO_DEVICE
        select CAMERA_OV3640
        select CAMERA_OV3640_AUTO_DETECT_DVP_INTERFACE_SENSOR
        select CAMERA_OV3640_DVP_YUV422_UYVY_1024X768_25FPS
        select CAMERA_OV3640_DVP_YUV422_UYVY_1280X720_15FPS
        select CAMERA_SC101IOT
        select CAMERA_SC101IOT_AUTO_DETECT_DVP_INTERFACE_SENSOR
        select CAMERA_SC101IOT_DVP_YUV422_1280X720_25FPS
        help
            Build the Mosaico OV3640 and SC101IOT camera profiles. The
            requested runtime format must be supported by the active sensor.

endmenu
```

## components/mosaico_nand_storage/Kconfig
```kconfig
menu "Mosaico NAND storage"
    config MOSAICO_NAND_STORAGE_ENABLE
        bool "Enable NAND LittleFS storage"
        default n
        select NAND_FLASH_ENABLE_BDL
        help
            Optional filesystem path. The legacy BSP page API remains available
            when the NAND block-device layer is disabled.

    if MOSAICO_NAND_STORAGE_ENABLE
        config MOSAICO_NAND_STORAGE_CLOCK_MHZ
            int "SPI clock override in MHz (0 follows BSP)"
            range 0 80
            default 0

        config MOSAICO_NAND_STORAGE_QIO
            bool "Use four NAND data pins"
            default y

        config MOSAICO_NAND_STORAGE_READ_CACHE_KIB
            int "Logical read cache in PSRAM (KiB, 0 disables)"
            range 0 128
            default 64
            help
                Write-through cache. Writes/erase invalidate affected pages;
                sync, ioctl and errors invalidate all cached pages.
                Allocation failure falls back to uncached reads.

        config MOSAICO_NAND_STORAGE_POLL_SHORT
            bool "Poll short page-load and READY commands"
            default y

        config MOSAICO_NAND_STORAGE_RECLAIM
            bool "Enable explicit post-commit reclamation"
            default y
            help
                Call maintenance after committed changes with all files and
                directories closed. Traversal and TRIM hold the VFS lock;
                a cold sweep can take seconds. Geometry and ECC are unchanged.
    endif
endmenu
```

## examples/ambient_light_adc/main/Kconfig.projbuild
```kconfig
menu "Ambient light ADC"
    config LIGHT_ADC_CALIBRATED
        bool "Use measured two-point calibration"
        default n
        help
            Enable only after measuring GPIO48 raw values at 0 mV and 2000 mV.
            Without calibration the UI displays raw counts, not a guessed voltage.
    config LIGHT_ADC_RAW_AT_ZERO
        int "Average raw value measured at 0 mV"
        range 0 131071
        default 0
        depends on LIGHT_ADC_CALIBRATED
    config LIGHT_ADC_RAW_AT_2V
        int "Average raw value measured at 2000 mV"
        range 0 131071
        default 0
        depends on LIGHT_ADC_CALIBRATED
endmenu
```

## examples/ambient_light_adc/sdkconfig.defaults
```kconfig
CONFIG_IDF_TARGET="esp32s31"
CONFIG_IDF_EXPERIMENTAL_FEATURES=y
CONFIG_COMPILER_OPTIMIZATION_PERF=y
CONFIG_FREERTOS_HZ=1000
CONFIG_ESPTOOLPY_FLASHSIZE_16MB=y
CONFIG_PARTITION_TABLE_SINGLE_APP_LARGE=y
CONFIG_ESP_CONSOLE_USB_SERIAL_JTAG=y
CONFIG_ESP_CONSOLE_SECONDARY_NONE=y
CONFIG_BSP_DISPLAY_ENABLE=y
CONFIG_SPIRAM=y
CONFIG_SPIRAM_MODE_OCT=y
CONFIG_SPIRAM_SPEED_250M=y
CONFIG_SPIRAM_MEMTEST=n
CONFIG_LV_COLOR_DEPTH_16=y
CONFIG_LV_OS_FREERTOS=y
CONFIG_LV_BUILD_EXAMPLES=n
CONFIG_LV_BUILD_DEMOS=n
CONFIG_LV_FONT_MONTSERRAT_20=y
CONFIG_LV_FONT_MONTSERRAT_28=y
CONFIG_LV_FONT_MONTSERRAT_48=y
CONFIG_LV_MEM_SIZE_KILOBYTES=64

# GPIO48 measurements supplied for this board: 0 V -> 2197, 2 V -> 162.
CONFIG_LIGHT_ADC_CALIBRATED=y
CONFIG_LIGHT_ADC_RAW_AT_ZERO=2197
CONFIG_LIGHT_ADC_RAW_AT_2V=162
```

## examples/camera_photo_app/main/Kconfig.projbuild
```kconfig
menu "Camera Photo App"

    config CAMERA_PHOTO_NAND_START_PAGE
        int "First logical NAND page used for photo storage"
        default 64
        range 1 2147483647
        help
            Logical page index where the photo catalog and JPEG files are stored.
            This region will be overwritten by saved photos.

    config CAMERA_PHOTO_MAX_COUNT
        int "Maximum number of photos stored on NAND"
        default 64
        range 1 256
        help
            Maximum number of JPEG files tracked by the on-flash catalog.

    config CAMERA_PHOTO_USB_MSC
        bool "Enable USB High-Speed MSC photo export (U-disk)"
        default n
        help
            Expose a FAT partition over USB OTG so a PC can browse exported
            JPEG files under DCIM/.

            When enabled, also configure in menuconfig:
            - Partition Table -> Custom partition table CSV (partitions.csv)
            - Component config -> TinyUSB -> Enable Mass Storage Class (MSC)

            sdkconfig.defaults keeps this disabled and uses SINGLE_APP_LARGE.

endmenu
```

## examples/camera_photo_app/sdkconfig.defaults
```kconfig
CONFIG_IDF_TARGET="esp32s31"
CONFIG_IDF_EXPERIMENTAL_FEATURES=y
CONFIG_COMPILER_OPTIMIZATION_PERF=y
CONFIG_FREERTOS_HZ=1000

# GPIO33 is camera D2 and shares the USB Serial/JTAG D- pad.
CONFIG_ESP_CONSOLE_UART_DEFAULT=y
# CONFIG_ESP_CONSOLE_USB_SERIAL_JTAG is not set
# CONFIG_ESP_CONSOLE_SECONDARY_USB_SERIAL_JTAG is not set
# CONFIG_USJ_ENABLE_USB_SERIAL_JTAG is not set

CONFIG_SPIRAM=y
CONFIG_SPIRAM_MODE_OCT=y
CONFIG_SPIRAM_SPEED_250M=y
CONFIG_SPIRAM_MEMTEST=n
CONFIG_SPIRAM_MALLOC_ALWAYSINTERNAL=4096
CONFIG_SPIRAM_ALLOW_BSS_SEG_EXTERNAL_MEMORY=y
CONFIG_SPIRAM_ALLOW_NOINIT_SEG_EXTERNAL_MEMORY=y

CONFIG_MOSAICO_CAMERA_OV3640=y
CONFIG_CAMERA_OV3640=y
CONFIG_CAMERA_OV3640_AUTO_DETECT_DVP_INTERFACE_SENSOR=y
CONFIG_CAMERA_OV3640_DVP_YUV422_UYVY_1024X768_25FPS=y
CONFIG_CAMERA_OV3640_DVP_DEFAULT_FMT_YUV422_UYVY_1024X768_25FPS=y

CONFIG_ESP_VIDEO_ENABLE_DVP_VIDEO_DEVICE=y

CONFIG_ESPTOOLPY_FLASHSIZE_16MB=y
CONFIG_BSP_NAND_USE_QIO=n

CONFIG_PARTITION_TABLE_SINGLE_APP_LARGE=y

CONFIG_LV_FONT_MONTSERRAT_20=y

# CONFIG_CAMERA_PHOTO_USB_MSC is not set
```

## examples/device_settings/sdkconfig.defaults
```kconfig
CONFIG_IDF_TARGET="esp32s31"
CONFIG_IDF_EXPERIMENTAL_FEATURES=y
CONFIG_COMPILER_OPTIMIZATION_PERF=y
CONFIG_ESPTOOLPY_FLASHSIZE_16MB=y
```

## examples/espnow_chat/sdkconfig.defaults
```kconfig
CONFIG_IDF_TARGET="esp32s31"
CONFIG_IDF_EXPERIMENTAL_FEATURES=y
CONFIG_COMPILER_OPTIMIZATION_PERF=y
CONFIG_ESPTOOLPY_FLASHSIZE_16MB=y
CONFIG_FREERTOS_HZ=1000

CONFIG_ESP_CONSOLE_UART_DEFAULT=y
CONFIG_ESP_CONSOLE_SECONDARY_USB_SERIAL_JTAG=y
```

## examples/gmf_audio_player/sdkconfig.defaults
```kconfig
CONFIG_IDF_TARGET="esp32s31"
CONFIG_IDF_EXPERIMENTAL_FEATURES=y
CONFIG_COMPILER_OPTIMIZATION_PERF=y
CONFIG_ESPTOOLPY_FLASHSIZE_16MB=y
CONFIG_FREERTOS_HZ=1000

CONFIG_PARTITION_TABLE_CUSTOM=y
CONFIG_PARTITION_TABLE_CUSTOM_FILENAME="partitions.csv"

CONFIG_ESP_CONSOLE_UART_DEFAULT=y
CONFIG_ESP_CONSOLE_SECONDARY_USB_SERIAL_JTAG=y

CONFIG_SPIRAM=y
CONFIG_SPIRAM_MODE_OCT=y
CONFIG_SPIRAM_SPEED_250M=y
CONFIG_SPIRAM_XIP_FROM_PSRAM=y
CONFIG_SPIRAM_MEMTEST=n
CONFIG_SPIRAM_MALLOC_ALWAYSINTERNAL=4096
CONFIG_SPIRAM_ALLOW_BSS_SEG_EXTERNAL_MEMORY=y
```

## examples/interaction_board_demo/sdkconfig.defaults
```kconfig
CONFIG_IDF_TARGET="esp32s31"
CONFIG_IDF_EXPERIMENTAL_FEATURES=y
CONFIG_COMPILER_OPTIMIZATION_PERF=y
CONFIG_ESPTOOLPY_FLASHSIZE_16MB=y
CONFIG_FREERTOS_HZ=1000

CONFIG_ESP_CONSOLE_UART_DEFAULT=y
CONFIG_ESP_CONSOLE_SECONDARY_USB_SERIAL_JTAG=y

CONFIG_LV_CONF_SKIP=y
CONFIG_LV_COLOR_DEPTH_16=y
CONFIG_LV_OS_FREERTOS=y
CONFIG_LV_DEF_REFR_PERIOD=15
CONFIG_LV_DPI_DEF=130
CONFIG_LV_USE_CLIB_MALLOC=y
CONFIG_LV_USE_CLIB_STRING=y
CONFIG_LV_USE_CLIB_SPRINTF=y
CONFIG_LV_FONT_MONTSERRAT_14=y
CONFIG_LV_FONT_MONTSERRAT_20=y
CONFIG_LV_FONT_MONTSERRAT_28=y

# QSPI frame buffers are allocated from PSRAM by esp_lvgl_adapter.
CONFIG_SPIRAM=y
CONFIG_SPIRAM_SPEED_250M=y
CONFIG_SPIRAM_XIP_FROM_PSRAM=y
CONFIG_SPIRAM_MEMTEST=n
```

## examples/magnetic_interaction_demo/main/Kconfig.projbuild
```kconfig
menu "Magnetic interaction demo"

config MAGNETIC_INTERACTION_USE_HARDWARE
    bool "Use calibrated BMM150 hardware input"
    default y
    help
        Read the two populated BMM150 sensors and use the ESP-Mosaico V1
        calibration profile. Disable this option to retain the touch-driven mock
        source for interaction, rotation, and orbit development. The calibrated
        hardware profile targets non-ferromagnetic desktop surfaces.

config MAGNETIC_INTERACTION_NETWORK_ID
    hex "Mosaico network ID"
    default 0x4D4F5341
    range 0x1 0xFFFFFFFF
    help
        Devices interact only with peers using the same network ID and radio
        channel. Use a different value for nearby independent assemblies.

config MAGNETIC_INTERACTION_ESPNOW_CHANNEL
    int "ESP-NOW radio channel"
    default 1
    range 1 14
    help
        Fixed primary channel used by every device in the assembly.

endmenu
```

## examples/magnetic_interaction_demo/sdkconfig.defaults
```kconfig
CONFIG_IDF_TARGET="esp32s31"
CONFIG_COMPILER_OPTIMIZATION_PERF=y
CONFIG_FREERTOS_HZ=1000
CONFIG_ESPTOOLPY_FLASHSIZE_16MB=y
CONFIG_PARTITION_TABLE_CUSTOM=y
CONFIG_PARTITION_TABLE_CUSTOM_FILENAME="partitions.csv"
CONFIG_MAGNETIC_INTERACTION_USE_HARDWARE=y

# Mosaico CO5300 QSPI display and CST9217 touch
CONFIG_BSP_CO5300_ENABLE_TE=y

# LVGL configuration (RGB565)
CONFIG_LV_CONF_SKIP=y
CONFIG_LV_COLOR_DEPTH_16=y
CONFIG_LV_OS_FREERTOS=y
CONFIG_LV_DEF_REFR_PERIOD=15
CONFIG_LV_DPI_DEF=130
CONFIG_LV_USE_CLIB_MALLOC=y
CONFIG_LV_USE_CLIB_STRING=y
CONFIG_LV_USE_CLIB_SPRINTF=y

# Fonts used by the UI
CONFIG_LV_FONT_MONTSERRAT_14=y
CONFIG_LV_FONT_MONTSERRAT_16=y
CONFIG_LV_FONT_MONTSERRAT_20=y
CONFIG_LV_FONT_MONTSERRAT_28=y

# QSPI frame buffers are allocated from PSRAM by esp_lvgl_adapter.
CONFIG_SPIRAM=y
CONFIG_SPIRAM_SPEED_250M=y
CONFIG_SPIRAM_XIP_FROM_PSRAM=y
CONFIG_SPIRAM_MEMTEST=n
```

## examples/matrix_rgb_led/sdkconfig.defaults
```kconfig
CONFIG_IDF_TARGET="esp32s31"
CONFIG_IDF_EXPERIMENTAL_FEATURES=y
CONFIG_ESPTOOLPY_FLASHSIZE_16MB=y
CONFIG_BSP_DISPLAY_ENABLE=y
CONFIG_BSP_DISPLAY_LVGL_ENABLE=y
CONFIG_LV_CONF_SKIP=y
CONFIG_LV_COLOR_DEPTH_16=y
CONFIG_LV_OS_FREERTOS=y
CONFIG_LV_USE_CLIB_MALLOC=y
CONFIG_LV_USE_CLIB_STRING=y
CONFIG_LV_USE_CLIB_SPRINTF=y
CONFIG_LV_FONT_MONTSERRAT_16=y
CONFIG_LV_FONT_MONTSERRAT_28=y

# BSP display frame buffers use PSRAM.
CONFIG_SPIRAM=y
CONFIG_SPIRAM_SPEED_250M=y
# CONFIG_SPIRAM_MEMTEST is not set
```

## examples/module_eeprom_programmer/sdkconfig.defaults
```kconfig
CONFIG_IDF_TARGET="esp32s31"
CONFIG_IDF_EXPERIMENTAL_FEATURES=y
CONFIG_ESPTOOLPY_FLASHSIZE_16MB=y
CONFIG_COMPILER_OPTIMIZATION_PERF=y
CONFIG_FREERTOS_HZ=1000
CONFIG_PARTITION_TABLE_SINGLE_APP_LARGE=y
CONFIG_ESP_MAIN_TASK_STACK_SIZE=8192

CONFIG_ESP_CONSOLE_UART_DEFAULT=y
CONFIG_ESP_CONSOLE_UART_BAUDRATE=115200

CONFIG_BSP_CO5300_ENABLE_TE=y

CONFIG_LV_CONF_SKIP=y
CONFIG_LV_COLOR_DEPTH_16=y
CONFIG_LV_OS_FREERTOS=y
CONFIG_LV_DEF_REFR_PERIOD=16
CONFIG_LV_DPI_DEF=60
CONFIG_LV_USE_CLIB_MALLOC=y
CONFIG_LV_USE_CLIB_STRING=y
CONFIG_LV_USE_CLIB_SPRINTF=y
CONFIG_LV_FONT_MONTSERRAT_16=y
CONFIG_LV_FONT_MONTSERRAT_20=y
CONFIG_LV_FONT_MONTSERRAT_28=y

CONFIG_SPIRAM=y
CONFIG_SPIRAM_MODE_OCT=y
CONFIG_SPIRAM_SPEED_250M=y
CONFIG_SPIRAM_XIP_FROM_PSRAM=y
CONFIG_SPIRAM_MEMTEST=n
```

## examples/module_slot_scan/sdkconfig.defaults
```kconfig
CONFIG_IDF_TARGET="esp32s31"
CONFIG_IDF_EXPERIMENTAL_FEATURES=y
CONFIG_COMPILER_OPTIMIZATION_PERF=y
CONFIG_ESPTOOLPY_FLASHSIZE_16MB=y
CONFIG_FREERTOS_HZ=1000

# GPIO33 is camera D2 and shares the USB Serial/JTAG D- pad.
CONFIG_ESP_CONSOLE_UART_DEFAULT=y
# CONFIG_ESP_CONSOLE_USB_SERIAL_JTAG is not set
# CONFIG_ESP_CONSOLE_SECONDARY_USB_SERIAL_JTAG is not set
# CONFIG_USJ_ENABLE_USB_SERIAL_JTAG is not set

CONFIG_BSP_CO5300_ENABLE_TE=y

CONFIG_LV_CONF_SKIP=y
CONFIG_LV_COLOR_DEPTH_16=y
CONFIG_LV_OS_FREERTOS=y
CONFIG_LV_DEF_REFR_PERIOD=15
CONFIG_LV_DPI_DEF=130
CONFIG_LV_USE_CLIB_MALLOC=y
CONFIG_LV_USE_CLIB_STRING=y
CONFIG_LV_USE_CLIB_SPRINTF=y
CONFIG_LV_FONT_MONTSERRAT_14=y
CONFIG_LV_FONT_MONTSERRAT_16=y
CONFIG_LV_FONT_MONTSERRAT_20=y
CONFIG_LV_USE_CANVAS=y
CONFIG_LV_USE_IMAGE=y

CONFIG_SPIRAM=y
CONFIG_SPIRAM_MODE_OCT=y
CONFIG_SPIRAM_SPEED_250M=y
CONFIG_SPIRAM_MEMTEST=n
CONFIG_SPIRAM_MALLOC_ALWAYSINTERNAL=4096
CONFIG_SPIRAM_ALLOW_BSS_SEG_EXTERNAL_MEMORY=y
CONFIG_SPIRAM_ALLOW_NOINIT_SEG_EXTERNAL_MEMORY=y

CONFIG_MOSAICO_MODULE_CAMERA=y
CONFIG_CAMERA_OV3640=y
CONFIG_CAMERA_OV3640_AUTO_DETECT_DVP_INTERFACE_SENSOR=y
CONFIG_CAMERA_OV3640_DVP_YUV422_UYVY_1024X768_25FPS=y
CONFIG_CAMERA_OV3640_DVP_DEFAULT_FMT_YUV422_UYVY_1024X768_25FPS=y
CONFIG_ESP_VIDEO_ENABLE_DVP_VIDEO_DEVICE=y
```

## examples/raylib_shooter/main/Kconfig.projbuild
```kconfig
menu "Mosaico Game OTA"

config GET_STARTED_RECOVERY
    bool
    default n

config GET_STARTED_AUTO_ACCEPT
    bool "Automatically accept a pending OTA image"
    default n
    help
        The game marks itself healthy only after its first frame is presented.

config GET_STARTED_ACCEPT_DELAY_MS
    int "Automatic acceptance delay (milliseconds)"
    range 1000 30000
    default 3000
    depends on GET_STARTED_AUTO_ACCEPT

config MOSAICO_GAME_DIAGNOSTIC_IRIS_ONLY
    bool "Boot only the ESP-Iris management plane"
    default n
    help
        Diagnostic escape hatch. Normal game builds must leave this disabled.

endmenu
```

## examples/sky_hop/main/Kconfig.projbuild
```kconfig
menu "Sky Hop benchmark"

config SKY_HOP_BENCHMARK_MODE
    bool "Run deterministic performance replay"
    default n
    help
        Starts and drives Sky Hop from a fixed input sequence. Use this only
        for repeatable device display benchmarks, not normal gameplay.

config SKY_HOP_TE_COMPOSE_BUFFERS
    int "TE compose buffer count"
    range 1 2
    default 1

config SKY_HOP_DRAWBUF_LINES
    int "Display draw-buffer lines"
    range 10 80
    default 34

endmenu
```
