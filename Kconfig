## examples/tof_distance/main/Kconfig.projbuild
```kconfig
menu "ToF Distance Demo"

    config TOF_GESTURE_DIAGNOSTICS
        bool "Log gesture sampling diagnostics every five seconds"
        default n
        help
            Report sample rates, validity, read latency and UI blocking time.
            Useful when checking missed gestures; does not log every sample.

    config TOF_DISTANCE_OFFSET_ADJUST_MM
        int "VL53L0X left slot additional distance offset (mm)"
        range -200 200
        default -37
        help
            Added to the sensor's initial offset after each hardware reset.
            Negative values reduce the measured distance. The -37 mm default
            is specific to a board reading 137 mm at a known 100 mm distance.
            Use 0 to disable this additional compensation. Re-measure when
            changing the sensor board or its optical/mechanical assembly.

    config TOF_DISTANCE_RIGHT_OFFSET_ADJUST_MM
        int "VL53L0X right slot additional distance offset (mm)"
        range -200 200
        default -37
        help
            Independent adjustment for the right sensor. Defaults to the same
            -37 mm correction as the left sensor. Verify accuracy on each board.
            Negative values reduce range.

    config TOF_L4CD_LEFT_OFFSET_ADJUST_MM
        int "VL53L4CD left slot additional distance offset (mm)"
        range -200 200
        default 0
        help
            Added to the VL53L4CD factory offset after reset. Zero preserves
            factory calibration. Measure this sensor before applying an offset;
            the VL53L0X board's -37 mm correction does not apply automatically.

    config TOF_L4CD_RIGHT_OFFSET_ADJUST_MM
        int "VL53L4CD right slot additional distance offset (mm)"
        range -200 200
        default 0
        help
            Independent adjustment for the right VL53L4CD. Zero preserves
            factory calibration. Negative values reduce the measured distance.

    config TOF_GESTURE_THRESHOLD_MM
        int "Gesture distance excursion threshold (mm)"
        range 20 500
        default 60
        help
            Minimum distance change relative to the stable background.
            A pulse completes after returning within half this threshold.

    config TOF_GESTURE_NEAR_MM
        int "Near-field hand detection distance (mm)"
        range 100 1000
        default 300
        help
            A valid target at or below this distance is a near-field hand.
            The field clears above this distance plus 60 mm, or with a
            signal-fail/no-confident-return status. No background is needed.
            VL53L0X phase fail at 8190/8191 mm also denotes no target here.
            Other invalid readings remain unknown. Stable valid backgrounds
            also retain the relative-distance detector as a fallback.

    config TOF_GESTURE_WINDOW_MS
        int "Gesture completion window (ms)"
        range 500 3000
        default 1500
        help
            Both sensors must complete their excursions within this time
            from the first excursion. Missing pairs are tolerated for up to
            80 ms; longer gaps or module loss cancel the gesture.

endmenu
```

## examples/tower_defense/sdkconfig.defaults
```kconfig
CONFIG_IDF_TARGET="esp32s31"
CONFIG_IDF_EXPERIMENTAL_FEATURES=y
CONFIG_SPIRAM=y
CONFIG_SPIRAM_SPEED_250M=y
CONFIG_SPIRAM_XIP_FROM_PSRAM=y
CONFIG_SPIRAM_MEMTEST=n
CONFIG_SPIRAM_USE_MALLOC=y
CONFIG_SPIRAM_ALLOW_STACK_EXTERNAL_MEMORY=n
CONFIG_ESP_COREDUMP_ENABLE_TO_FLASH=y
CONFIG_ESP_COREDUMP_CHECK_BOOT=y
CONFIG_ESP_COREDUMP_MAX_TASKS_NUM=24
CONFIG_COMPILER_OPTIMIZATION_PERF=y
CONFIG_FREERTOS_HZ=1000
CONFIG_ESP_MAIN_TASK_STACK_SIZE=20480
CONFIG_ESPTOOLPY_FLASHSIZE_16MB=y
CONFIG_PARTITION_TABLE_CUSTOM=y
CONFIG_PARTITION_TABLE_CUSTOM_FILENAME="partitions.csv"
CONFIG_BOOTLOADER_APP_ROLLBACK_ENABLE=y
CONFIG_FACTORY_RECOVERY_BOOT_GPIO=7
CONFIG_FACTORY_RECOVERY_BOOT_DEBOUNCE_MS=50

CONFIG_ESP_CONSOLE_USB_SERIAL_JTAG=y
CONFIG_ESP_CONSOLE_SECONDARY_NONE=y
CONFIG_ESP_IRIS_TRANSPORT_USB=y
CONFIG_ESP_IRIS_TRANSPORT_TCP=y
CONFIG_ESP_IRIS_TRANSPORT_CLAIM_TIMEOUT_MS=2000
CONFIG_ESP_IRIS_TCP_PORT=19772
CONFIG_ESP_IRIS_TCP_PAIRING=y
CONFIG_ESP_IRIS_TASK_STACK_SIZE=3328
CONFIG_TINYUSB_CDC_RX_BUFSIZE=8192
CONFIG_TINYUSB_CDC_TX_BUFSIZE=8192
CONFIG_TINYUSB_CDC_EP_BUFSIZE=8192

CONFIG_BSP_CO5300_ENABLE_TE=y
CONFIG_APP_PROJECT_VER_FROM_CONFIG=y
CONFIG_APP_PROJECT_VER="1.0.0"
CONFIG_ESP_IRIS_OTA_DEFAULT_VIA_RECOVERY=y
CONFIG_ESP_IRIS_USB_PRODUCT="ESP-Iris Mosaico Tower Defense"
```
