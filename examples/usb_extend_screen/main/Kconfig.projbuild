## examples/usb_extend_screen/main/Kconfig.projbuild
```kconfig
menu "USB Extend Screen Example"

    config TUSB_VID
        hex "USB Device VID"
        default 0x303A
    config TUSB_PID
        hex "USB Device PID"
        default 0x2986 if HID_TOUCH_ENABLE || UAC_AUDIO_ENABLE
        default 0x2987 if !HID_TOUCH_ENABLE && !UAC_AUDIO_ENABLE
    config TUSB_MANUFACTURER
        string "USB Device Manufacture"
        default "Espressif"
    config TUSB_PRODUCT
        string "Product Name"
        default "udisp"

    menu "USB extend screen configuration"
        config USB_EXTEND_SCREEN_WIDTH
            int "USB logical display width"
            default 480
            range 160 480
            help
                Resolution exposed to the PC. The image is hardware-scaled to
                the 480-pixel-wide Mosaico panel. A smaller value makes desktop
                content appear larger.

        config USB_EXTEND_SCREEN_HEIGHT
            int "USB logical display height"
            default 480
            range 160 480
            help
                Resolution exposed to the PC. The image is hardware-scaled to
                the 480-pixel-high Mosaico panel. A smaller value makes desktop
                content appear larger.

        config USB_EXTEND_SCREEN_JPEG_QUALITY
            int "USB extend screen jpeg quality"
            default 10
            range 1 10
            help
                JPEG quality hint embedded in the USB vendor string for the PC driver.

        config USB_EXTEND_SCREEN_MAX_FPS
            int "USB extend screen max fps"
            default 60
            range 1 60
            help
                Maximum frame rate reported to the PC driver.

        config USB_EXTEND_SCREEN_FRAME_LIMIT_B
            int "Maximum frame image (B)"
            default 500000
            help
                Maximum JPEG payload size accepted from the PC driver.
    endmenu

    config USB_TASK_PRIORITY
        int "USB Task Priority"
        default 6
        range 1 15

    config VENDOR_TASK_PRIORITY
        int "Vendor Task Priority"
        default 5
        range 1 15

    config HID_TOUCH_ENABLE
        bool "Enable HID Touch Report"
        default y
        help
            Report CST9217 touch events to the PC as a HID digitizer.

    config HID_TASK_PRIORITY
        int "HID Task Priority"
        depends on HID_TOUCH_ENABLE
        default 5
        range 1 15

    config TOUCH_TASK_PRIORITY
        int "Touch Task Priority"
        depends on HID_TOUCH_ENABLE
        default 5
        range 1 15

    config UAC_AUDIO_ENABLE
        bool "Enable UAC Audio"
        default y
        help
            Stream audio to/from the PC through the ES8311 codec.

    config UAC_MIC_GAIN_DB
        int "UAC microphone gain (dB)"
        depends on UAC_AUDIO_ENABLE && UAC_MIC_CHANNEL_NUM > 0
        range 0 42
        default 24

    config EXAMPLE_LCD_BUF_COUNT
        int "LCD decode buffer count"
        default 2
        range 1 3

endmenu
```

## examples/usb_extend_screen/sdkconfig.defaults
```kconfig
CONFIG_IDF_TARGET="esp32s31"
CONFIG_IDF_EXPERIMENTAL_FEATURES=y
CONFIG_COMPILER_OPTIMIZATION_PERF=y
CONFIG_PERIPH_CTRL_FUNC_IN_IRAM=y
CONFIG_FREERTOS_HZ=1000

# Use UART for logs; USB-OTG is reserved for the extend-screen device stack.
CONFIG_ESP_CONSOLE_UART_DEFAULT=y
CONFIG_ESP_CONSOLE_SECONDARY_USB_SERIAL_JTAG=y
# CONFIG_ESP_CONSOLE_USB_SERIAL_JTAG is not set
# CONFIG_USJ_ENABLE_USB_SERIAL_JTAG is not set

CONFIG_SPIRAM=y
CONFIG_SPIRAM_MODE_OCT=y
CONFIG_SPIRAM_SPEED_250M=y
CONFIG_SPIRAM_XIP_FROM_PSRAM=y
CONFIG_SPIRAM_MEMTEST=n
CONFIG_SPIRAM_MALLOC_RESERVE_INTERNAL=12768
CONFIG_SPIRAM_ALLOW_BSS_SEG_EXTERNAL_MEMORY=y
CONFIG_SPIRAM_ALLOW_NOINIT_SEG_EXTERNAL_MEMORY=y

CONFIG_ESPTOOLPY_FLASHSIZE_16MB=y
CONFIG_PARTITION_TABLE_SINGLE_APP_LARGE=y

CONFIG_CODEC_ES8311_SUPPORT=y

CONFIG_USB_DEVICE_UAC_AS_PART=y

CONFIG_HID_TOUCH_ENABLE=y
CONFIG_ESP_LCD_TOUCH_MAX_POINTS=5
CONFIG_UAC_AUDIO_ENABLE=y
CONFIG_UAC_SPEAKER_CHANNEL_NUM=2
CONFIG_UAC_MIC_CHANNEL_NUM=2
CONFIG_UAC_SAMPLE_RATE=48000
CONFIG_UAC_BIT_RESOLUTION_16=y
CONFIG_UAC_SPK_INTERVAL_MS=10
CONFIG_UAC_MIC_INTERVAL_MS=10
CONFIG_UAC_SPK_NEW_PLAY_INTERVAL=100
CONFIG_UAC_SPK_TASK_PRIORITY=6
CONFIG_UAC_MIC_TASK_PRIORITY=6

CONFIG_USB_EXTEND_SCREEN_MAX_FPS=60
CONFIG_USB_EXTEND_SCREEN_FRAME_LIMIT_B=500000
CONFIG_EXAMPLE_LCD_BUF_COUNT=2
```

## examples/voice_tts/sdkconfig.defaults
```kconfig
CONFIG_IDF_TARGET="esp32s31"
CONFIG_IDF_EXPERIMENTAL_FEATURES=y
CONFIG_COMPILER_OPTIMIZATION_PERF=y
CONFIG_ESPTOOLPY_FLASHSIZE_16MB=y
CONFIG_FREERTOS_HZ=1000

CONFIG_PARTITION_TABLE_CUSTOM=y
CONFIG_PARTITION_TABLE_CUSTOM_FILENAME="partitions.csv"

CONFIG_SPIRAM=y
CONFIG_SPIRAM_MODE_OCT=y
CONFIG_SPIRAM_SPEED_250M=y
CONFIG_SPIRAM_XIP_FROM_PSRAM=y
CONFIG_SPIRAM_MEMTEST=n

CONFIG_CODEC_ES8311_SUPPORT=y
```

## expansion_modules/mosaico_module_camera/Kconfig
```kconfig
menu "Mosaico Camera Subboard"

    config MOSAICO_CAMERA_OV3640
        bool "Enable the Mosaico OV3640 DVP camera"
        default y
        select ESP_VIDEO_ENABLE_DVP_VIDEO_DEVICE
        select CAMERA_OV3640
        select CAMERA_OV3640_AUTO_DETECT_DVP_INTERFACE_SENSOR
        select CAMERA_OV3640_DVP_YUV422_UYVY_1024X768_25FPS
        help
            Build the fixed Mosaico camera subboard profile. The public API
            selects 1024x768 UYVY at runtime and uses the external 24 MHz
            oscillator fitted on the camera subboard.

endmenu
```
